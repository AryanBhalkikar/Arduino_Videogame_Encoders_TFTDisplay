/* Encoder Library, for measuring quadrature encoded signals
 * http://www.pjrc.com/teensy/td_libs_Encoder.html
*/

/* TFT_22_ILI9225 library
* https://github.com/Nkawu/TFT_22_ILI9225/tree/master/src
*/

#include <Encoder.h>          //Encoder.h library for handling encoders
#include <SPI.h>              //SPI library for communication with tft
#include <TFT_22_ILI9225.h>   //Library for ILI9225 display

// Initialize two Encoder objects for left and right knobs with their respective pin pairs
Encoder knobLeft(2, 5);
Encoder knobRight(3, 4);

// Define pin numbers for the two switch buttons
int swPin1 = 6;
int swPin2 = 7;

// Define pin assignments for the TFT display
#define TFT_RST A4
#define TFT_RS  A3
#define TFT_CS  A5  // SS
#define TFT_SDI A2  // MOSI
#define TFT_CLK A1  // SCK
#define TFT_LED 0   // LED is hardwired to +5V
#define TFT_BRIGHTNESS 200

// Variables to store the coordinates of Ship 1's vertices
int Ship1C1X;
int Ship1C1Y;
int Ship1C2X;
int Ship1C2Y;
int Ship1C3X;
int Ship1C3Y;

// Variables to store the coordinates of Ship 2's vertices
int Ship2C1X;
int Ship2C1Y;
int Ship2C2X;
int Ship2C2Y;
int Ship2C3X;
int Ship2C3Y;

// Variables to define the mirror's position and movement
int mirrorTopLeftX;
int mirrorTopLeftY;
int mirrorBotRightX;
int mirrorBotRightY;
int mirrorCenterY;
int mirrorTravel = 15; //Mirror movement increment

// Variables to store the raw encoder values
int rawDisplayLeft;
int rawDisplayRight;

// Timing variables for mirror updates
unsigned long lastMirrorUpdate = 0;
const unsigned long mirrorInterval = 80;

// Variables to track the points points of both ships
int ship1Health = 0;
int ship2Health = 0;
String str = "Points: ";

// Variables to store previous display positions for comparison
int prevDisplayLeft = 0;
int prevDisplayRight = 0;

// Timing variables for shot cooldowns and delays
unsigned long shotTime1 = 0;       // Left ship shot time
unsigned long shotLineTime1 = 0;   // When the left shot line was drawn
unsigned long shotTime2 = 0;       // Right ship shot time
unsigned long shotLineTime2 = 0;   // When the right shot line was drawn

const unsigned long shotCooldown = 400; //Shot cooldown
int delayTime = 1000; //delay after successful hit

unsigned long temp1;

//initial timer value
int val=61;

// Initialize the TFT display object with the defined pin assignments and brightness
TFT_22_ILI9225 tft = TFT_22_ILI9225(TFT_RST, TFT_RS, TFT_CS, TFT_SDI, TFT_CLK, TFT_LED, TFT_BRIGHTNESS);


static const uint8_t PROGMEM startMenuBitmap[] = {
  
 0x00, 0x00, 0x00, 0x00, 0x00, 0x00, 0x00, 0x00, 0x00, 0x00, 0x00, 0x00, 0x00, 0x00, 0x00, 0x00, 
	0x00, 0x00, 0x00, 0x00, 0x00, 0x00, 0x00, 0x00, 0x00, 0x00, 0x00, 0x00, 0x00, 0x00, 0x00, 0x00, 
	0x00, 0x00, 0x00, 0x00, 0x00, 0x00, 0x00, 0x00, 0x00, 0x00, 0x00, 0x00, 0x00, 0x00, 0x00, 0x00, 
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	0xff, 0xff, 0xff, 0xe0, 0x00, 0x00, 0x00, 0x00
};

static const uint8_t PROGMEM winBitmap [] = {
  0x00, 0x00, 0x00, 0x00, 0x00, 0x00, 0x00, 0x00, 0x00, 0x00, 0x00, 0x00, 0x00, 0x00, 0x00, 0x00, 
	0x00, 0x00, 0x00, 0x00, 0x00, 0x00, 0x00, 0x00, 0x00, 0x00, 0x00, 0x00, 0x00, 0x00, 0x00, 0x00, 
	0x00, 0x00, 0x00, 0x00, 0x00, 0x00, 0x00, 0x00, 0x00, 0x00, 0x00, 0x00, 0x00, 0x00, 0x00, 0x00, 
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	0x00, 0x00, 0x00, 0x00, 0x00, 0x00, 0x00, 0x00
};

 static const uint8_t PROGMEM gameBackground[] = {
  0x00, 0x00, 0x00, 0x00, 0x00, 0x00, 0x00, 0x00, 0x00, 0x00, 0x00, 0x00, 0x00, 0x00, 0x00, 0x00, 
	0x00, 0x00, 0x00, 0x00, 0x00, 0x00, 0x00, 0x00, 0x00, 0x00, 0x00, 0x00, 0x00, 0x00, 0x00, 0x00, 
	0x00, 0x00, 0x00, 0x00, 0x00, 0x00, 0x00, 0x00, 0x00, 0x00, 0x00, 0x00, 0x00, 0x00, 0x00, 0x00, 
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	0x00, 0x00, 0x00, 0x00, 0x00, 0x00, 0x00, 0x00, 0x00, 0x00, 0x00, 0x00, 0x00, 0x00, 0x00, 0x00
};

// Function to initialize the game state
void initGame() {

  tft.clear();
  tft.drawBitmap(5, 10, gameBackground, 176, 200, COLOR_WHITE);

  // Set initial coordinates for Ship 1 (bottom of the screen)
  Ship1C1X = 0;
  Ship1C1Y = tft.maxY() - 12;
  Ship1C2X = 8;
  Ship1C2Y = tft.maxY() - 19;
  Ship1C3X = 16;
  Ship1C3Y = tft.maxY() - 12;

  // Set initial coordinates for Ship 2 (top of the screen)
  Ship2C1X = tft.maxX() - 16;
  Ship2C1Y = 12;
  Ship2C2X = tft.maxX() - 8;
  Ship2C2Y = 19;
  Ship2C3X = tft.maxX();
  Ship2C3Y = 12;

  ship1Health = 0;
  ship2Health = 0;

  // Set initial mirror position and dimensions
  mirrorTopLeftX = 0;
  mirrorTopLeftY = 109;
  mirrorBotRightX = 20;
  mirrorBotRightY = 111;
  mirrorCenterY = 110;

  // Reset encoder positions and display variables
  knobLeft.write(0);
  knobRight.write(0);
  rawDisplayLeft = 0;
  rawDisplayRight = 0;
  prevDisplayLeft = 0;
  prevDisplayRight = 0;

   // Draw the mirror and ships on the TFT display
  tft.fillRectangle(mirrorTopLeftX, mirrorTopLeftY, mirrorBotRightX, mirrorBotRightY, COLOR_YELLOW);
  tft.fillTriangle(Ship1C1X, Ship1C1Y, Ship1C2X, Ship1C2Y, Ship1C3X, Ship1C3Y, COLOR_CYAN);
  tft.fillTriangle(Ship2C1X, Ship2C1Y, Ship2C2X, Ship2C2Y, Ship2C3X, Ship2C3Y, COLOR_MAGENTA);

  // Set font and display initial health points
  tft.setFont(Terminal6x8);
  tft.drawText(0, tft.maxY()-8, str + ship1Health, COLOR_MAGENTA);
  tft.drawText(tft.maxX()-60, tft.maxY()-8, str + ship2Health, COLOR_CYAN);

  // Initialize timer variables
  temp1 = millis();
  val=61;
}

//Function to display start menu
void startMenu(){
  tft.clear();
  tft.drawBitmap(0,0,startMenuBitmap,176,220,COLOR_WHITE);

  //Waits on start menu until at least one encoder is pressed
  while(1){
    int button1 = digitalRead(swPin1);
    int button2 = digitalRead(swPin2);
    if (button1 == LOW || button2 == LOW){
      break;
    }
  }
}

//Function to display restart menu
void restartMenu(){

  //if ship 2 wins
  if (ship1Health < ship2Health){
    tft.setFont(Terminal12x16);
    tft.drawText(12, 12, "MAGENTA WINS!!!", COLOR_MAGENTA);
    tft.drawBitmap(0,40, winBitmap, 176, 180, COLOR_WHITE);
    while(1){
      int button1 = digitalRead(swPin1);
      int button2 = digitalRead(swPin2);
      if (button1 == LOW || button2 == LOW){
        break;
      }
    }
  }

  //if ship1 wins
  else if (ship2Health < ship1Health){
    tft.setFont(Terminal12x16);
    tft.drawText(30, 12, "CYAN WINS!!!", COLOR_CYAN);
    tft.drawBitmap(0,40, winBitmap, 176, 180, COLOR_WHITE);
    while(1){
      int button1 = digitalRead(swPin1);
      int button2 = digitalRead(swPin2);
      if (button1 == LOW || button2 == LOW){
        break;
      }
    }
  }

  //Reinitializes game variables to restart game once either of the encoders is pressed
  initGame();
}

void setup() {
  pinMode(swPin1, INPUT_PULLUP);
  pinMode(swPin2, INPUT_PULLUP);

  tft.begin();

  startMenu();

  initGame();
}

void loop() {

  if (val <= 0){
    tft.clear();
    restartMenu();
  }

  //Timer logic: increments timer every 1000 milliseconds
  if(millis()-temp1>=1000)
  {
    temp1 = millis();
    val--;
    String t;

    if (val >= 10){
      t = "Timer: ";
    }
    else{
      t = "Timer: 0";
    }
    
    tft.drawText(tft.maxX() - 120, 0, t + val, COLOR_WHITE);
  }

  //Logic for the movement of mirror across the screen
  unsigned long now = millis();
  if (now - lastMirrorUpdate >= mirrorInterval) { //ensures the mirror moves at a more or less constant velocity

    tft.fillRectangle(mirrorTopLeftX, mirrorTopLeftY, mirrorBotRightX, mirrorBotRightY, COLOR_BLACK);

    //Move mirror towards right when it touches the left of the display
    if (mirrorTopLeftX <= 0) {
      mirrorTravel = abs(mirrorTravel);
    }

    //change direction of mirror when it touches the right of the display
    if (mirrorBotRightX >= tft.maxX()) {
      mirrorTravel = -abs(mirrorTravel);
    }

    //update mirror position
    mirrorTopLeftX += mirrorTravel;
    mirrorBotRightX += mirrorTravel;

    tft.fillRectangle(mirrorTopLeftX, mirrorTopLeftY, mirrorBotRightX, mirrorBotRightY, COLOR_YELLOW);

    lastMirrorUpdate = now;
  }

  //taking rotational input from encoders
  rawDisplayLeft = -knobLeft.read() / 2;
  rawDisplayRight = -knobRight.read() / 2;
 
  //Constraining the input values so that it doesn't go out of the screen
  int displayLeft = constrain(rawDisplayLeft, 0, 21);
  int displayRight = constrain(rawDisplayRight, -21, 0);
  
  //if the input from encoder changes, ship position is updated
  if (displayLeft != prevDisplayLeft) {
    tft.fillTriangle(Ship1C1X + 7.5 * prevDisplayLeft, Ship1C1Y, Ship1C2X + 7.5 * prevDisplayLeft, Ship1C2Y, Ship1C3X + 7.5 * prevDisplayLeft, Ship1C3Y, COLOR_BLACK);
                     
    tft.fillTriangle(Ship1C1X + 7.5 * displayLeft, Ship1C1Y, Ship1C2X + 7.5 * displayLeft, Ship1C2Y, Ship1C3X + 7.5 * displayLeft, Ship1C3Y, COLOR_CYAN);
                     
    prevDisplayLeft = displayLeft;
  }
  if (displayRight != prevDisplayRight) {
    tft.fillTriangle(Ship2C1X + 7.5 * prevDisplayRight, Ship2C1Y, Ship2C2X + 7.5 * prevDisplayRight, Ship2C2Y, Ship2C3X + 7.5 * prevDisplayRight, Ship2C3Y, COLOR_BLACK);
                     
    tft.fillTriangle(Ship2C1X + 7.5 * displayRight, Ship2C1Y, Ship2C2X + 7.5 * displayRight, Ship2C2Y, Ship2C3X + 7.5 * displayRight, Ship2C3Y, COLOR_MAGENTA);
                     
    prevDisplayRight = displayRight;
  }

  //Calculating ship (triangle) center for drawing laser beam
  int ship1CenterX = (Ship1C1X + Ship1C2X + Ship1C3X) / 3 + 7.5 * displayLeft;
  int ship1CenterY = (Ship1C1Y + Ship1C2Y + Ship1C3Y) / 3;
  int ship2CenterX = (Ship2C1X + Ship2C2X + Ship2C3X) / 3 + 7.5 * displayRight;
  int ship2CenterY = (Ship2C1Y + Ship2C2Y + Ship2C3Y) / 3;
  
  //reads clicking of encoder 1
  int button1 = digitalRead(swPin1);

  unsigned long now1 = millis(); // timer for shot cooldown
  
  //if button 1 is pressed and cooldown period has passed, a laser beam is fired
  if (button1 == LOW && now1 - shotTime1 >= shotCooldown) {
    tft.drawLine(ship1CenterX, ship1CenterY, ship1CenterX, 12, COLOR_CYAN);
    shotLineTime1 = now1;
    shotTime1 = now1;

    //if beam hits mirror, opponent gains a point
    if (ship1CenterX >= mirrorTopLeftX && ship1CenterX <= mirrorBotRightX) {
      tft.drawLine(ship1CenterX, mirrorCenterY, ship1CenterX, 12, COLOR_BLACK);
      ship2Health++;
      tft.drawText(0, tft.maxY()-8, str + ship2Health, COLOR_MAGENTA);
      delay (delayTime);
    }

    //if beam hits opponent, this player wins a point
    else if (ship1CenterX >= (Ship2C1X + 7.5 * displayRight) && ship1CenterX <= (Ship2C3X + 7.5 * displayRight)){
      ship1Health++;
      tft.drawText(tft.maxX()-60, tft.maxY()-8, str + ship1Health, COLOR_CYAN);
      delay(delayTime);
    }
  }

  //erasing the laser beams
  if (shotLineTime1 != 0) {
    tft.drawLine(ship1CenterX, ship1CenterY, ship1CenterX, 12, COLOR_BLACK);
    shotLineTime1 = 0;
  }

  //Same logic as above but for the other encoder: 

  int button2 = digitalRead(swPin2);

  unsigned long now2 = millis();

  if (button2 == LOW && now2 - shotTime2 >= shotCooldown) {
    tft.drawLine(ship2CenterX, ship2CenterY, ship2CenterX, tft.maxY()-12, COLOR_MAGENTA);
    shotLineTime2 = now2;
    shotTime2 = now2;

    if (ship2CenterX >= mirrorTopLeftX && ship2CenterX <= mirrorBotRightX) {
      tft.drawLine(ship2CenterX, mirrorCenterY, ship2CenterX, tft.maxY()-12, COLOR_BLACK);
      ship1Health++;
      tft.drawText(tft.maxX()-60, tft.maxY()-8, str + ship1Health, COLOR_CYAN);
      delay(delayTime);
    }
    else if (ship2CenterX >= (Ship1C1X + 7.5 * displayLeft) && ship2CenterX <= (Ship1C3X + 7.5 * displayLeft)){
      ship2Health++;
      tft.drawText(0, tft.maxY()-8, str + ship2Health, COLOR_MAGENTA);
      delay(delayTime);
    }
  }
  if (shotLineTime2 != 0) {
    tft.drawLine(ship2CenterX, ship2CenterY, ship2CenterX, tft.maxY()-12, COLOR_BLACK);
    shotLineTime2 = 0;
  }
}